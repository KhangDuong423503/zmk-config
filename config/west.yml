## config/west.yml
```yaml
manifest:
  remotes:
    - name: zmkfirmware
      url-base: https://github.com/zmkfirmware
    - name: KhangDuong423503
      url-base: https://github.com/KhangDuong423503
  projects:
    - name: zmk
      remote: KhangDuong423503
      revision: mouse
      import: app/west.yml
  self:
    path: config
```
